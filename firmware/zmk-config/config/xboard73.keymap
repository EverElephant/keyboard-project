/*
 * xboard73 keymap — 73 键
 *
 * 层：
 *   0 — 默认层 (Base)
 *   1 — 功能层 (Fn)
 */

#include <behaviors.dtsi>
#include <dt-bindings/zmk/keys.h>

/ {
    layers {
        compatible = "zmk,layers";

        /* ─── 默认层 ─── */
        base_layer {
            bindings = <
    /*  Esc       `       1        2        3        4       5       6       7       8       9       0       -       =       Bspc */
    &kp ESC   &kp GRAVE &kp N1   &kp N2   &kp N3   &kp N4  &kp N5  &kp N6  &kp N7  &kp N8  &kp N9  &kp N0  &kp MINUS &kp EQUAL &kp BSPC
    /*  F1       Tab      Q        W        E        R       T       Y       U       I       O       P       [       ]       \ */
    &kp F1    &kp TAB   &kp Q    &kp W    &kp E    &kp R   &kp T   &kp Y   &kp U   &kp I   &kp O   &kp P   &kp LBKT &kp RBKT &kp BSLH
    /*  F2       Caps     A        S        D        F       G       H       J       K       L       ;       '       Enter */
    &kp F2    &kp CAPS  &kp A    &kp S    &kp D    &kp F   &kp G   &kp H   &kp J   &kp K   &kp L   &kp SEMICOLON &kp APOSTROPHE &kp ENTER
    /*  F3       LShift   Z        X        C        V       B       N       M       ,       .       /       RShift */
    &kp F3    &kp LSHFT &kp Z    &kp X    &kp C    &kp V   &kp B   &kp N   &kp M   &kp COMMA &kp DOT &kp FSLH &kp RSHFT
    /*  F4       LCtrl    LWin     LAlt           Space               RAlt    Fn      RCtrl */
    &kp F4    &kp LCTRL &kp LGUI &kp LALT &kp SPC  &kp RALT &mo 1   &kp RCTL
    /*  Ins      Del     PgUp    PgDn      ↑       ←       ↓       → */
    &kp INS   &kp DEL   &kp PGUP &kp PGDN &kp UP  &kp LEFT &kp DOWN &kp RGHT
            >;
        };

        /* ─── 功能层 (Fn) ─── */
        fn_layer {
            bindings = <
    /*  Esc       `       1        2        3        4       5       6       7       8       9       0       -       =       Bspc */
    &kp ESC   &kp GRAVE &kp N1   &kp N2   &kp N3   &kp N4  &kp N5  &kp N6  &kp N7  &kp N8  &kp N9  &kp N0  &kp MINUS &kp EQUAL &kp BSPC
    /*  F1       Tab      Q        W        E        R       T       Y       U       I       O       P       [       ]       \ */
    &kp F1    &kp TAB   &kp Q    &kp W    &kp E    &kp R   &kp T   &kp Y   &kp U   &kp I   &kp O   &kp P   &kp LBKT &kp RBKT &kp BSLH
    /*  F2       Caps     A        S        D        F       G       H       J       K       L       ;       '       Enter */
    &kp F2    &kp CAPS  &kp A    &kp S    &kp D    &kp F   &kp G   &kp H   &kp J   &kp K   &kp L   &kp SEMICOLON &kp APOSTROPHE &kp ENTER
    /*  F3       LShift   Z        X        C        V       B       N       M       ,       .       /       RShift */
    &kp F3    &kp LSHFT &kp Z    &kp X    &kp C    &kp V   &kp B   &kp N   &kp M   &kp COMMA &kp DOT &kp FSLH &kp RSHFT
    /*  F4       LCtrl    LWin     LAlt           Space               RAlt    Fn      RCtrl */
    &trans    &trans    &trans   &trans   &trans   &trans   &trans  &trans
    /*  Ins      Del     PgUp    PgDn      ↑       ←       ↓       → */
    &kp HOME  &kp END  &kp F5   &kp F6   &kp F7  &kp F8  &kp F9  &kp F10
            >;
        };
    };
};
